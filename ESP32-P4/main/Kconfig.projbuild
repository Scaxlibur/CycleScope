## ESP32-P4/main/Kconfig.projbuild
```kconfig
menu "CycleScope CSLP Configuration"

    config CYCLESCOPE_CSLP_PEER_IPV4
        string "CSLP peer IPv4 address"
        default "192.168.10.2"
        help
            Dotted-decimal IPv4 address of the FPGA or test emulator.
            Production builds use 192.168.10.2. The configured address must
            match the source address used by the peer.

    config CYCLESCOPE_CSLP_DIAGNOSTIC_CONSUMER
        bool "Enable the CSLP frame ownership diagnostic consumer"
        default n
        help
            Start a low-priority test-only consumer that acquires the latest
            frame, verifies that an InUse buffer remains immutable, checks
            session validity, and releases the frame. Keep this disabled in
            production and never enable it alongside another CSLP consumer.

    config CYCLESCOPE_CSLP_DISABLE_PUSH_TEST
        bool "Run one DISABLE/CONFIG/ENABLE lifecycle test"
        default n
        help
            Test-only receiver-task trigger. After eight completed frames in
            the first ready session, perform DISABLE_PUSH, repeat CONFIG_SET,
            and ENABLE_PUSH without changing the session. Keep this disabled
            in production; it exists only for the controlled host fixture in
            tool-of-rei/test.

    if CYCLESCOPE_CSLP_DIAGNOSTIC_CONSUMER

        config CYCLESCOPE_CSLP_DIAGNOSTIC_HOLD_MS
            int "Diagnostic frame hold time (ms)"
            range 50 5000
            default 250
            help
                Time to retain each acquired InUse frame while the network
                receiver continues publishing newer frames.

    endif

endmenu
```

## ESP32-P4/sdkconfig.defaults
```kconfig
# ESP-IDF 6.0.2 display bring-up defaults for ESP32-P4 Function EV Board.
CONFIG_IDF_TARGET="esp32p4"
# The target board uses pre-v0.3 ESP32-P4 silicon.
CONFIG_ESP32P4_SELECTS_REV_LESS_V3=y
CONFIG_ESP_DEFAULT_CPU_FREQ_MHZ_360=y
CONFIG_ESPTOOLPY_FLASHMODE_QIO=y
CONFIG_ESPTOOLPY_FLASHSIZE_16MB=y
CONFIG_PARTITION_TABLE_CUSTOM=y
CONFIG_PARTITION_TABLE_OFFSET=0x10000
CONFIG_COMPILER_OPTIMIZATION_PERF=y
CONFIG_SPIRAM=y
CONFIG_SPIRAM_SPEED_250M=y
CONFIG_SPIRAM_XIP_FROM_PSRAM=y
CONFIG_CACHE_L2_CACHE_256KB=y
CONFIG_CACHE_L2_CACHE_LINE_128B=y
CONFIG_ESP_MAIN_TASK_STACK_SIZE=10240
CONFIG_FREERTOS_HZ=1000
CONFIG_FREERTOS_VTASKLIST_INCLUDE_COREID=y
CONFIG_FREERTOS_GENERATE_RUN_TIME_STATS=y

# ESP32-P4 Function EV Board onboard IP101, RMII internal EMAC.
CONFIG_ETHERNET_INTERNAL_SUPPORT=y
CONFIG_ETHERNET_PHY_INTERFACE_RMII=y
CONFIG_ETHERNET_RMII_CLK_INPUT=y
CONFIG_ETHERNET_RMII_CLK_GPIO=50
CONFIG_ETHERNET_RMII_TX_EN_GPIO=49
CONFIG_ETHERNET_RMII_TXD0_GPIO=34
CONFIG_ETHERNET_RMII_TXD1_GPIO=35
CONFIG_ETHERNET_RMII_CRS_DV_GPIO=28
CONFIG_ETHERNET_RMII_RXD0_GPIO=29
CONFIG_ETHERNET_RMII_RXD1_GPIO=30
CONFIG_ETHERNET_PHY_IP101=y
CONFIG_ETHERNET_MDC_GPIO=31
CONFIG_ETHERNET_MDIO_GPIO=52
CONFIG_ETHERNET_PHY_RST_GPIO=51
CONFIG_ETHERNET_PHY_ADDR=1
CONFIG_ETHERNET_DMA_BURST_LEN_DEFAULT=y
CONFIG_ETHERNET_RX_TASK_STACK_SIZE=4096
CONFIG_ETHERNET_RX_TASK_PRIO=7
CONFIG_ETHERNET_DEFAULT_EVENT_HANDLER=y
CONFIG_ETHERNET_BOARD_SPECIFIC_INIT_NONE=y

# Keep enough lwIP queueing for one burst of CSLP waveform datagrams.
CONFIG_LWIP_SO_RCVBUF=y
CONFIG_LWIP_UDP_RECVMBOX_SIZE=64
CONFIG_LWIP_TCPIP_RECVMBOX_SIZE=64
CONFIG_LWIP_CHECKSUM_CHECK_UDP=y

CONFIG_BSP_LCD_DPI_BUFFER_NUMS=3
CONFIG_LV_USE_CLIB_MALLOC=y
CONFIG_LV_USE_CLIB_STRING=y
CONFIG_LV_USE_CLIB_SPRINTF=y
CONFIG_LV_DEF_REFR_PERIOD=15
CONFIG_LV_OS_FREERTOS=y
CONFIG_LV_DRAW_SW_DRAW_UNIT_CNT=2
CONFIG_LV_ATTRIBUTE_FAST_MEM_USE_IRAM=y
CONFIG_LV_FONT_MONTSERRAT_12=y
CONFIG_LV_FONT_MONTSERRAT_16=y
CONFIG_LV_FONT_MONTSERRAT_18=y
CONFIG_LV_FONT_MONTSERRAT_22=y
CONFIG_LV_USE_FONT_COMPRESSED=y
CONFIG_LV_TXT_BREAK_CHARS=" ,.;:-_"
CONFIG_LV_USE_SYSMON=y
CONFIG_LV_USE_PERF_MONITOR=y
CONFIG_LV_USE_IMGFONT=y
CONFIG_LV_USE_DEMO_BENCHMARK=y
CONFIG_LV_USE_DEMO_RENDER=y
CONFIG_LV_USE_DEMO_SCROLL=y
CONFIG_LV_USE_DEMO_STRESS=y
CONFIG_LV_USE_DEMO_TRANSFORM=y
CONFIG_LV_USE_DEMO_MUSIC=y
CONFIG_LV_DEMO_MUSIC_AUTO_PLAY=y
CONFIG_LV_USE_DEMO_FLEX_LAYOUT=y
CONFIG_LV_USE_DEMO_MULTILANG=y
CONFIG_IDF_EXPERIMENTAL_FEATURES=y
```
